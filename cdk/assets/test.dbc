VERSION "Created by canmatrix and CSS Electronics (www.csselectronics.com)"

NS_ :

BS_:

BU_:

BO_ 2024 OBD2: 8 Vector__XXX
 SG_ S1_PID_00_PIDsSupported_01_20 m0 : 31|32@0+ (1,0) [0|4294967295] "" Vector__XXX
 SG_ S1_PID_05_EngineCoolantTemp m5 : 31|8@0+ (1,-40) [-40|215] "degC" Vector__XXX
 SG_ S1_PID_0C_EngineRPM m12 : 31|16@0+ (0.25,0) [0|16383.75] "rpm" Vector__XXX
 SG_ S1_PID_0D_VehicleSpeed m13 : 31|8@0+ (1,0) [0|255] "km/h" Vector__XXX
 SG_ S1_PID_11_ThrottlePosition m17 : 31|8@0+ (0.39216,0) [0|100] "%" Vector__XXX
 SG_ ParameterID_Service01 m1M : 23|8@0+ (1,0) [0|255] "" Vector__XXX
 SG_ ParameterID_Service02 m2M : 23|8@0+ (1,0) [0|255] "" Vector__XXX
 SG_ service M : 11|4@0+ (1,0) [0|15] "" Vector__XXX
 SG_ response : 15|4@0+ (1,0) [0|15] "" Vector__XXX
 SG_ length : 7|8@0+ (1,0) [0|255] "" Vector__XXX

CM_ BO_ 2024 "OBD2 DBC developed by canmatrix & CSS Electronics - for questions contact us at www.csselectronics.com";
CM_ SG_ 2024 S1_PID_00_PIDsSupported_01_20 "PIDs supported [01 - 20] - Bit encoded [A7..D0] == [PID $01..PID $20]. See OBD-II PIDs on Wikipedia";
CM_ SG_ 2024 S1_PID_01_MonitorStatus "Monitor status since DTCs cleared (includes malfunction indicator lamp (MIL) status and number of DTCs) ";
CM_ SG_ 2024 S1_PID_20_PIDsSupported_21_40 "PIDs supported [21 - 40] - Bit encoded [A7..D0] == [PID $21..PID $40]. See OBD-II PIDs on Wikipedia";
CM_ SG_ 2024 S1_PID_40_PIDsSupported_41_60 "PIDs supported [41 - 60] - Bit encoded [A7..D0] == [PID $41..PID $60]. See OBD-II PIDs on Wikipedia";
CM_ SG_ 2024 S1_PID_60_PIDsSupported_61_80 "PIDs supported [61 - 80] - Bit encoded [A7..D0] == [PID $61..PID $80]. See OBD-II PIDs on Wikipedia";
CM_ SG_ 2024 S1_PID_80_PIDsSupported_81_A0 "PIDs supported [81 - A0] - Bit encoded [A7..D0] == [PID $81..PID $A0]. See OBD-II PIDs on Wikipedia";
CM_ SG_ 2024 S1_PID_A0_PIDsSupported_A1_C0 "PIDs supported [A1 - C0] - Bit encoded [A7..D0] == [PID $A1..PID $C0]. See OBD-II PIDs on Wikipedia";
CM_ SG_ 2024 S1_PID_C0_PIDsSupported_C1_E0 "PIDs supported [C1 - E0] - Bit encoded [A7..D0] == [PID $C1..PID $E0]. See OBD-II PIDs on Wikipedia";
BA_DEF_ BO_  "VFrameFormat" ENUM  "StandardCAN","ExtendedCAN","StandardCAN_FD","ExtendedCAN_FD","J1939PG";
BA_DEF_  "ProtocolType" STRING ;
BA_DEF_DEF_  "VFrameFormat" "";
BA_DEF_DEF_  "ProtocolType" "";
BA_ "ProtocolType" "OBD2";
BA_ "VFrameFormat" BO_ 2024 0;
VAL_ 2024 S1_PID_03_FuelSystemStatus 1 "Open loop (insuff. eng. temp.)" 2 "Closed loop (oxy sens)" 4 "Open loop (eng. load, fuel cut)" 8 "Open loop (system failure)" 16 "Closed loop (feedback issue)" ;
VAL_ 2024 S1_PID_12_CmdSecAirStatus 1 "Upstream" 2 "Downstream catalytic conv" 4 "From outside atmosphere/off" 8 "Pump cmd on for diagn." ;
VAL_ 2024 S1_PID_1C_OBDStandard 1 "OBD-II as defined by the CARB" 2 "OBD as defined by the EPA" 3 "OBD and OBD-II" 4 "OBD-I" 5 "Not OBD compliant" 6 "EOBD (Europe)" 7 "EOBD and OBD-II" 8 "EOBD and OBD" 9 "EOBD, OBD and OBD II" 10 "JOBD (Japan)" 11 "JOBD and OBD II" 12 "JOBD and EOBD" 13 "JOBD, EOBD, and OBD II" 14 "Reserved" 15 "Reserved" 16 "Reserved" 17 "Eng. Manu. Diag. (EMD)" 18 "EMD Enhanced (EMD+)" 19 "HD OBD-C" 20 "HD OBD" 21 "WWH OBD" 22 "Reserved" 23 "HD EOBD-I" 24 "HD EOBD-I N" 25 "HD EOBD-II" 26 "HD EOBD-II N" 27 "Reserved" 28 "OBDBr-1" 29 "OBDBr-2" 30 "KOBD" 31 "IOBD I" 32 "IOBD II" 33 "HD EOBD-IV" 34 "Reserved" 35 "Reserved" ;
VAL_ 2024 S1_PID_51_FuelType 0 "Not available" 1 "Gasoline" 2 "Methanol" 3 "Ethanol" 4 "Diesel" 5 "LPG" 6 "CNG" 7 "Propane" 8 "Electric" 9 "Bifuel running Gasoline" 10 "Bifuel running Methanol" 11 "Bifuel running Ethanol" 12 "Bifuel running LPG" 13 "Bifuel running CNG" 14 "Bifuel running Propane" 15 "Bifuel running Electricity" 16 "Bifuel electric/comb. eng." 17 "Hybrid gasoline" 18 "Hybrid Ethanol" 19 "Hybrid Diesel" 20 "Hybrid Electric" 21 "Hybrid running electric/comb." 22 "Hybrid Regenerative" 23 "Bifuel running diesel" ;
VAL_ 2024 ParameterID_Service01 0 "S1_PID_00_PIDsSupported_01_20" 1 "S1_PID_01_MonitorStatus" 2 "S1_PID_02_FreezeDTC" 3 "S1_PID_03_FuelSystemStatus" 4 "S1_PID_04_CalcEngineLoad" 5 "S1_PID_05_EngineCoolantTemp" 6 "S1_PID_06_ShortFuelTrimBank1" 7 "S1_PID_07_LongFuelTrimBank1" 8 "S1_PID_08_ShortFuelTrimBank2" 9 "S1_PID_09_LongFuelTrimBank2" 10 "S1_PID_0A_FuelPressure" 11 "S1_PID_0B_IntakeManiAbsPress" 12 "S1_PID_0C_EngineRPM" 13 "S1_PID_0D_VehicleSpeed" 14 "S1_PID_0E_TimingAdvance" 15 "S1_PID_0F_IntakeAirTemperature" 16 "S1_PID_10_MAFAirFlowRate" 17 "S1_PID_11_ThrottlePosition" 18 "S1_PID_12_CmdSecAirStatus" 20 "S1_PID_14_OxySensor1" 21 "S1_PID_15_OxySensor2" 22 "S1_PID_16_OxySensor3" 23 "S1_PID_17_OxySensor4" 24 "S1_PID_18_OxySensor5" 25 "S1_PID_19_OxySensor6" 26 "S1_PID_1A_OxySensor7" 27 "S1_PID_1B_OxySensor8" 28 "S1_PID_1C_OBDStandard" 31 "S1_PID_1F_TimeSinceEngStart" 32 "S1_PID_20_PIDsSupported_21_40" 33 "S1_PID_21_DistanceMILOn" 34 "S1_PID_22_FuelRailPres" 35 "S1_PID_23_FuelRailGaug" 36 "S1_PID_24_OxySensor1" 37 "S1_PID_25_OxySensor2" 38 "S1_PID_26_OxySensor3" 39 "S1_PID_27_OxySensor4" 40 "S1_PID_28_OxySensor5" 41 "S1_PID_29_OxySensor6" 42 "S1_PID_2A_OxySensor7" 43 "S1_PID_2B_OxySensor8" 44 "S1_PID_2C_CmdEGR" 45 "S1_PID_2D_EGRError" 46 "S1_PID_2E_CmdEvapPurge" 47 "S1_PID_2F_FuelTankLevel" 48 "S1_PID_30_WarmUpsSinceCodeClear" 49 "S1_PID_31_DistanceSinceCodeClear" 50 "S1_PID_32_EvapSysVaporPres" 51 "S1_PID_33_AbsBaroPres" 52 "S1_PID_34_OxySensor1" 53 "S1_PID_35_OxySensor2" 54 "S1_PID_36_OxySensor3" 55 "S1_PID_37_OxySensor4" 56 "S1_PID_38_OxySensor5" 57 "S1_PID_39_OxySensor6" 58 "S1_PID_3A_OxySensor7" 59 "S1_PID_3B_OxySensor8" 60 "S1_PID_3C_CatTempBank1Sens1" 61 "S1_PID_3D_CatTempBank2Sens1" 62 "S1_PID_3E_CatTempBank1Sens2" 63 "S1_PID_3F_CatTempBank2Sens2" 64 "S1_PID_40_PIDsSupported_41_60" 65 "S1_PID_41_MonStatusDriveCycle" 66 "S1_PID_42_ControlModuleVolt" 67 "S1_PID_43_AbsLoadValue" 68 "S1_PID_44_FuelAirCmdEquiv" 69 "S1_PID_45_RelThrottlePos" 70 "S1_PID_46_AmbientAirTemp" 71 "S1_PID_47_AbsThrottlePosB" 72 "S1_PID_48_AbsThrottlePosC" 73 "S1_PID_49_AbsThrottlePosD" 74 "S1_PID_4A_AbsThrottlePosE" 75 "S1_PID_4B_AbsThrottlePosF" 76 "S1_PID_4C_CmdThrottleAct" 77 "S1_PID_4D_TimeRunMILOn" 78 "S1_PID_4E_TimeSinceCodeClear" 79 "S1_PID_4F_MaxMultiple" 80 "S1_PID_50_Max_AirFlowMAF" 81 "S1_PID_51_FuelType" 82 "S1_PID_52_EthanolFuelPct" 83 "S1_PID_53_AbsEvapSysVapPres" 84 "S1_PID_54_EvapSysVapPres" 85 "S1_PID_55_ShortSecOxyTrimBankX" 86 "S1_PID_56_LongSecOxyTrimBankX" 87 "S1_PID_57_ShortSecOxyTrimBankX" 88 "S1_PID_58_LongSecOxyTrimBankX" 89 "S1_PID_59_FuelRailAbsPres" 90 "S1_PID_5A_RelAccelPedalPos" 91 "S1_PID_5B_HybrBatPackRemLife" 92 "S1_PID_5C_EngineOilTemp" 93 "S1_PID_5D_FuelInjectionTiming" 94 "S1_PID_5E_EngineFuelRate" 95 "S1_PID_5F_EmissionReq" 96 "S1_PID_60_PIDsSupported_61_80" 97 "S1_PID_61_DemandEngTorqPct" 98 "S1_PID_62_ActualEngTorqPct" 99 "S1_PID_63_EngRefTorq" 100 "S1_PID_64_EngPctTorq" 101 "S1_PID_65_AuxInputOutput" 102 "S1_PID_66_MAFSensor" 103 "S1_PID_67_EngineCoolantTemp" 104 "S1_PID_68_IntakeAirTempSens" 105 "S1_PID_69_CmdEGR_EGRError" 106 "S1_PID_6A_CmdDieselIntAir" 107 "S1_PID_6B_ExhaustGasTemp" 108 "S1_PID_6C_CmdThrottleActRel" 109 "S1_PID_6D_FuelPresContrSys" 110 "S1_PID_6E_InjPresContrSys" 111 "S1_PID_6F_TurboComprPres" 112 "S1_PID_70_BoostPresCntrl" 128 "S1_PID_80_PIDsSupported_81_A0" 142 "S1_PID_8E_EngFrictionPctTorq" 160 "S1_PID_A0_PIDsSupported_A1_C0" 192 "S1_PID_C0_PIDsSupported_C1_E0" ;
VAL_ 2024 ParameterID_Service02 2 "S2_PID_02_FreezeDTC" ;
VAL_ 2024 service 10 "Permanent DTCs (Cleared DTCs) " 9 "Request vehicle information " 8 "Control on-board system " 7 "Show pending DTCs " 6 "Other system monitoring " 5 "Oxygen sensor monitoring " 4 "Clear DTCs and stored values" 3 "Show stored DTCs " 2 "Show freeze frame data " 1 "Show current data " ;

SG_MUL_VAL_ 2024 S1_PID_05_EngineCoolantTemp ParameterID_Service01 5-5;
SG_MUL_VAL_ 2024 S1_PID_0C_EngineRPM ParameterID_Service01 12-12;
SG_MUL_VAL_ 2024 S1_PID_0D_VehicleSpeed ParameterID_Service01 13-13;
SG_MUL_VAL_ 2024 S1_PID_11_ThrottlePosition ParameterID_Service01 17-17;
SG_MUL_VAL_ 2024 ParameterID_Service01 service 1-1;
SG_MUL_VAL_ 2024 ParameterID_Service02 service 2-2;
